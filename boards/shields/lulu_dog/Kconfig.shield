## boards/shields/lulu_dog/Kconfig.shield
```kconfig
# Copyright (c) 2022 The ZMK Contributors
# SPDX-License-Identifier: MIT

config SHIELD_LULU_DOG
    def_bool $(shields_list_contains,lulu_dog)
```

## boards/shields/walkies/Kconfig.defconfig
```kconfig
if SHIELD_WALKIES

config LS0XX_VCOM_THREAD_PRIO
    default 11

choice ZMK_DISPLAY_WORK_QUEUE
    default ZMK_DISPLAY_WORK_QUEUE_DEDICATED
endchoice

choice ZMK_DISPLAY_STATUS_SCREEN
    default ZMK_DISPLAY_STATUS_SCREEN_CUSTOM
endchoice

config ZMK_DISPLAY_STATUS_SCREEN_CUSTOM
    select LV_USE_CANVAS
    select ZMK_WPM if ZMK_SPLIT_ROLE_CENTRAL

config LV_Z_MEM_POOL_SIZE
    default 8192

# Keep the existing board/user orientation setting available for this shield.
config NICE_VIEW_ROTATE_180
    bool "Rotate the Walkies display 180 degrees"

endif
```

## dts/bindings/behaviors/custom,walkies-sync.yaml
```yaml
description: Internal Walkies display activity relay
compatible: "custom,walkies-sync"
include: two_param.yaml
```
